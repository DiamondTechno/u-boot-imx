## board/diamondtech/imx91/Kconfig
```kconfig
if TARGET_IMX91_DEC

config SYS_BOARD
	default "imx91"

config SYS_VENDOR
	default "diamondtech"

config SYS_CONFIG_NAME
	default "imx91_dec"

choice
	prompt "Select method to choose LPDDR4 timing for TARGET_IMX91_DEC"
	default DEC_IMX91_LPDDR4_TIMING_BY_EEPROM

config DEC_IMX91_LPDDR4_TIMING_BY_EEPROM
	bool "Using Diamond Technologies EEPROM contents for LPDDR4 timing selection"
	help
	  Select the LPDDR4 timing based on contents of EEPROM on SOM.
	  The EEPROM stores the DDR size and rank so the SPL can pick the
	  correct 2400 MT/s timing.

endchoice

choice
	prompt "LPDDR4 failsafe timing (used when EEPROM is absent or blank)"
	default DEC_IMX91_FAILSAFE_DRAM_512MB_1600MTS
	depends on DEC_IMX91_LPDDR4_TIMING_BY_EEPROM

config DEC_IMX91_FAILSAFE_DRAM_2GB_RANK2
	bool "2 GB / 2400 MT/s / rank2 (IMAG16L4JCDG-046I)"
	help
	  Use the 2 GB dual-rank LPDDR4 timing as the fallback when the
	  EEPROM has not been programmed. Correct for boards populated with
	  the IMAG16L4JCDG-046I (16 Gb, dual-rank, x16, 1 channel, 2400 MT/s).

config DEC_IMX91_FAILSAFE_DRAM_512MB_1600MTS
	bool "512 MB / 1600 MT/s / rank1 (universal failsafe)"
	help
	  512 MB single-rank LPDDR4 timing at 1600 MT/s. Used as the failsafe
	  when EEPROM is blank. Lower speed provides wider margins for parts
	  that may not train reliably at 2400 MT/s without exact EEPROM config.
	  Once EEPROM is programmed the device will switch to the 2400 MT/s
	  timing on next boot.

config DEC_IMX91_FAILSAFE_DRAM_512MB_RANK1
	bool "512 MB / 2400 MT/s / rank1 / 60-ohm CA ODT"
	help
	  Use the 512 MB single-rank LPDDR4 timing as the fallback when the
	  EEPROM has not been programmed. Correct for boards populated with
	  a 512 MB single-rank LPDDR4 device.

config DEC_IMX91_FAILSAFE_DRAM_512MB_RANK1_CAODT120
	bool "512 MB / 2400 MT/s / rank1 / 120-ohm CA ODT (universal failsafe)"
	help
	  512 MB address mapping with 120-ohm CA ODT. Intended as a universal
	  failsafe that works on both single-rank 512 MB parts and rank2 die
	  (e.g. IMAG16L4JCDG-046I) used with rank1 addressing. Use this when
	  a single image must cold-boot any part before EEPROM is programmed.

endchoice

config DEC_IMX91_MIN_SDRAM_SIZE_MB
	int "Minimum required SDRAM size in MB (0 = no minimum)"
	default 0
	help
	  If non-zero, the SPL falls back to the failsafe timing if the
	  EEPROM-reported DRAM size is less than this value.

endif
```

## board/diamondtech/imx93/Kconfig
```kconfig
if TARGET_IMX93_DEC

config SYS_BOARD
	default "imx93"

config SYS_VENDOR
	default "diamondtech"

config SYS_CONFIG_NAME
	default "imx93_dec"

choice
	prompt "Select method to choose LPDDR4x timing for TARGET_IMX93_DEC"
	default DEC_IMX93_LPDDR4X_TIMING_BY_NAME

config DEC_IMX93_LPDDR4X_TIMING_BY_NAME
	bool "Using DEC_IMX93_LPDDR4X_TIMING_FILENAME for LPDDR4x Timing selection"
	help
	  Select the LPDDR4x timing based on specified filename

config DEC_IMX93_LPDDR4X_TIMING_BY_BOARD_ID
	bool "Using Diamond Technologies HW Board ID for LPDDR4x Timing selection"
	help
	  Select the LPDDR4x timing based on Board ID

config DEC_IMX93_LPDDR4X_TIMING_BY_EEPROM
	bool "Using Diamond Technologies EEPROM contents for LPDDR4x Timing selection"
	help
	  Select the LPDDR4x timing based on contents of EEPROM on SOM

endchoice

config DEC_IMX93_LPDDR4X_TIMING_FILENAME
	string "Specify the LPDDR4x Timing Filename"
    depends on DEC_IMX93_LPDDR4X_TIMING_BY_NAME
	default "dec_lpddr4x_1gbyte_3200mts_timing"
	help
	  Name of the timing file to use when DEC_IMX93_LPDDR4X_TIMING_BY_NAME is used.

config DEC_IMX93_MIN_SDRAM_SIZE_MB
	int "Minimum required SDRAM size in MB (0 = no minimum)"
	default 0
	help
	  If non-zero, the SPL falls back to the failsafe 1GB timing if the
	  EEPROM-reported DRAM size is below this value. Set to 1024 for
	  machines that require at least 1 GB of DDR (e.g. those using video or
	  M33 remoteproc with reserved memory above the 512 MB mark).

endif
```
